## esp-mosaico-recovery/firmware/recovery/main/Kconfig.projbuild
```kconfig
menu "Iris Factory Recovery"

config FACTORY_RECOVERY_FIRMWARE
    bool
    default y
    select MBEDTLS_CERTIFICATE_BUNDLE
    select ESP_IRIS_OTA
    help
        Identify this project as the retained Recovery firmware and enable the
        Recovery-only ESP-Iris OTA writer.

config IRIS_FACTORY_WIFI_MAX_NETWORKS
    int "Maximum Wi-Fi scan results shown"
    range 4 16
    default 16

config IRIS_FACTORY_WIFI_CONNECT_TIMEOUT_MS
    int "Wi-Fi connection timeout (milliseconds)"
    range 5000 60000
    default 15000

config IRIS_FACTORY_MDNS_PREFIX
    string "mDNS hostname prefix"
    default "mosaico"

config IRIS_FACTORY_SYSTEM_UPDATE_BACKEND
    bool "Register the unsigned full-system update Flash backend"
    default y
    depends on ESP_IRIS_SYSTEM_UPDATE && !SECURE_FLASH_ENC_ENABLED
    help
        Accept unsigned manifests and allow recovery to update ota_0, the
        bootloader, the partition table, or its own factory image.
        Transport/session access control, manifest/component SHA-256, image
        validation and protected-partition policy still apply, but there is no
        release-key authentication.

        System-update v1 requires the current and target partition tables to
        contain the exact otadata, phy_init, sysmeta, factory Recovery and
        coredump contracts. Other partitions may change. Application and data
        images are written through descriptors derived from the validated
        target partition table before that table is committed last.

        A factory self-update is an isolated Recovery-only transaction. The
        partition table is not a component; its SHA-256 is an explicit source
        layout precondition, and the factory image must cover the complete
        fixed slot. It requires XIP from PSRAM and accepts a power-loss window
        recoverable only through ROM download mode.

        This first product backend intentionally rejects flash-encrypted
        builds. System Inventory remains available without a writer.

config IRIS_FACTORY_BRIDGE_SERVER_URL
    string "Bridge HTTPS Origin (no trailing slash)"
    default ""
    help
        Empty disables registration. Set the deployed certificate-verified
        HTTPS Origin in the consuming workspace's build configuration.

config IRIS_FACTORY_BRIDGE_BOARD_ID
    string "Bridge board compatibility identifier"
    default ""
    help
        Required before entering Bridge download mode. Factory update
        manifests must match this board identifier.

config IRIS_FACTORY_BRIDGE_SYSTEM_UPDATE
    bool "Enable Bridge full system-update bundles"
    default y
    depends on IRIS_FACTORY_SYSTEM_UPDATE_BACKEND
    help
        Advertise the system_update capability and accept validated .irisfw
        transactions from the configured HTTPS Bridge service. This is local
        product policy; incoming manifests cannot enable the capability.
        Legacy application/data/layout and Recovery self-update modes are
        unaffected. Validate the complete product on hardware before enabling.

config IRIS_FACTORY_BRIDGE_BOOTLOADER_UPDATE
    bool "Allow Bridge bootloader replacement"
    default y
    depends on IRIS_FACTORY_BRIDGE_SYSTEM_UPDATE
    help
        Advertise bootloader_update and allow the Bridge source to stage a
        bootloader and matching partition table in the shared writer backend.
        Commit writes the bootloader first and partition table last, with
        readback verification. Power loss can require ROM recovery. Remote
        manifests cannot change this local permission.

config IRIS_FACTORY_NAND_SYSTEM_UPDATE
    bool "Enable recovery NAND LittleFS system-update source"
    default n
    depends on IRIS_FACTORY_SYSTEM_UPDATE_BACKEND
    select NAND_FLASH_ENABLE_BDL
    help
        Register RPC 0x1201/2. Its payload is an absolute manifest path below
        /nand. Recovery mounts the board SPI NAND LittleFS read-write, exposes
        the complete /nand tree as the writable ESP-Iris volume "nand", and
        reads the manifest plus every root-level component from its directory.
        Mount failures never format the NAND and do not prevent Recovery USB
        maintenance from starting.
        The Recovery UI scans /nand/system-update/manifest.json and one level
        of release subdirectories so an operator can select a bundle locally.

config IRIS_FACTORY_NAND_SYSTEM_UPDATE_TASK_STACK
    int "NAND system-update task stack size"
    range 6144 16384
    default 8192
    depends on IRIS_FACTORY_NAND_SYSTEM_UPDATE

config IRIS_FACTORY_NAND_SYSTEM_UPDATE_AUTO_START
    bool "Automatically apply the configured NAND bundle in Recovery"
    default n
    depends on IRIS_FACTORY_NAND_SYSTEM_UPDATE

config IRIS_FACTORY_NAND_SYSTEM_UPDATE_MANIFEST_PATH
    string "Automatic NAND system-update manifest path"
    default "/nand/system-update/manifest.json"
    depends on IRIS_FACTORY_NAND_SYSTEM_UPDATE_AUTO_START
    help
        Absolute LittleFS path below /nand. Component file names in the
        manifest are resolved relative to this file. Leave empty to disable
        auto-start.

endmenu
```

## mosaico-tools/templates/raylib_lite_iris/sdkconfig.defaults
```kconfig
CONFIG_IDF_TARGET="esp32s31"
CONFIG_IDF_EXPERIMENTAL_FEATURES=y
CONFIG_SPIRAM=y
CONFIG_SPIRAM_SPEED_250M=y
CONFIG_SPIRAM_XIP_FROM_PSRAM=y
CONFIG_SPIRAM_MEMTEST=n
CONFIG_SPIRAM_USE_MALLOC=y
CONFIG_SPIRAM_ALLOW_STACK_EXTERNAL_MEMORY=n
CONFIG_ESP_COREDUMP_ENABLE_TO_FLASH=y
CONFIG_ESP_COREDUMP_CHECK_BOOT=y
CONFIG_ESP_COREDUMP_MAX_TASKS_NUM=24
CONFIG_COMPILER_OPTIMIZATION_PERF=y
CONFIG_FREERTOS_HZ=1000
CONFIG_ESP_MAIN_TASK_STACK_SIZE=20480
CONFIG_ESPTOOLPY_FLASHSIZE_16MB=y
CONFIG_PARTITION_TABLE_CUSTOM=y
CONFIG_PARTITION_TABLE_CUSTOM_FILENAME="partitions.csv"
CONFIG_BOOTLOADER_APP_ROLLBACK_ENABLE=y
CONFIG_FACTORY_RECOVERY_BOOT_GPIO=7
CONFIG_FACTORY_RECOVERY_BOOT_DEBOUNCE_MS=50

# USB High-Speed is owned by ESP-Iris. Device installation and logs go through
# mosaico.py. Keep the console on UART and avoid the USB Serial/JTAG controller.
CONFIG_ESP_CONSOLE_UART_DEFAULT=y
# CONFIG_ESP_CONSOLE_USB_SERIAL_JTAG is not set
CONFIG_ESP_CONSOLE_SECONDARY_NONE=y
CONFIG_ESP_IRIS_TRANSPORT_USB=y
CONFIG_ESP_IRIS_TRANSPORT_TCP=y
CONFIG_ESP_IRIS_TRANSPORT_CLAIM_TIMEOUT_MS=2000
CONFIG_ESP_IRIS_TCP_PORT=19772
CONFIG_ESP_IRIS_TCP_PAIRING=y
CONFIG_ESP_IRIS_TASK_STACK_SIZE=3328
CONFIG_ESP_IRIS_WIRE_BUFFERS_PSRAM=y
CONFIG_TINYUSB_CDC_RX_BUFSIZE=2048
CONFIG_TINYUSB_CDC_TX_BUFSIZE=2048
CONFIG_TINYUSB_CDC_EP_BUFSIZE=2048

CONFIG_BSP_CO5300_ENABLE_TE=y
CONFIG_APP_PROJECT_VER_FROM_CONFIG=y
CONFIG_APP_PROJECT_VER="1.0.0"

# Keep the BSP/LVGL display stack at the verified 16-bit FreeRTOS settings.
CONFIG_LV_CONF_SKIP=y
CONFIG_LV_COLOR_DEPTH_16=y
CONFIG_LV_OS_FREERTOS=y
CONFIG_LV_USE_CLIB_MALLOC=y
CONFIG_LV_USE_CLIB_STRING=y
CONFIG_LV_USE_CLIB_SPRINTF=y
```
